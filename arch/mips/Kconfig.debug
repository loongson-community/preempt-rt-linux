## arch/mips/Kconfig.debug
```kconfig
menu "Kernel hacking"

config TRACE_IRQFLAGS_SUPPORT
	bool
	default y

source "lib/Kconfig.debug"

config CMDLINE
	string "Default kernel command string"
	default ""
	help
	  On some platforms, there is currently no way for the boot loader to
	  pass arguments to the kernel. For these platforms, you can supply
	  some command-line options at build time by entering them here.  In
	  other cases you can specify kernel args so that you don't have
	  to set them up in board prom initialization routines.

config DEBUG_STACK_USAGE
	bool "Enable stack utilization instrumentation"
	depends on DEBUG_KERNEL
	help
	  Enables the display of the minimum amount of free stack which each
	  task has ever had available in the sysrq-T and sysrq-P debug output.

	  This option will slow down process creation somewhat.

config SMTC_IDLE_HOOK_DEBUG
	bool "Enable additional debug checks before going into CPU idle loop"
	depends on DEBUG_KERNEL && MIPS_MT_SMTC
	help
	  This option enables Enable additional debug checks before going into
	  CPU idle loop.  For details on these checks, see
	  arch/mips/kernel/smtc.c.  This debugging option result in significant
	  overhead so should be disabled in production kernels.

config SB1XXX_CORELIS
	bool "Corelis Debugger"
	depends on SIBYTE_SB1xxx_SOC
	select DEBUG_INFO
	help
	  Select compile flags that produce code that can be processed by the
	  Corelis mksym utility and UDB Emulator.

config RUNTIME_DEBUG
	bool "Enable run-time debugging"
	depends on DEBUG_KERNEL
	help
	  If you say Y here, some debugging macros will do run-time checking.
	  If you say N here, those macros will mostly turn to no-ops.  See
	  arch/mips/include/asm/debug.h for debugging macros.
	  If unsure, say N.

config KFT
	bool "Kernel Function Trace"
	help
	  Say Y here to turn on kernel function tracing.
	  This allows you to get a trace of kernel functions
	  during kernel execution.  This can be helpful for
	  debugging, but adds overhead to every kernel function
	  invocation.  The overhead is small, but still present,
	  even when tracing is not active.

	  See the file Documentation/kft.txt for more information.
          Say N here if you are unsure.

config KFT_STATIC_RUN
	bool "Static function tracing configuration"
	depends on KFT
	help
	  Say Y here to compile the KFT configuration statically
	  into the kernel.  This is needed if you plan to use KFT
	  to get information about function timings on kernel bootup
	  (prior to the kernel starting user space).  To do this, you
	  need to create a valid kernel/kftstatic.conf file.

config KFT_CLOCK_SCALE
	int "Scaling factor for early initialization of KFT clock"
	depends on KFT
	default 0
	help
	  Enter the number used for clock scaling early in the machine
	  bootup sequence.  This is required on many platforms in order
	  for KFT to work correctly before time_init().  You need to investigate
	  your kernel source to find out what data element or routine this
	  number is used with, and experiment to find the correct value to
	  use here.

	  If unsure what to do, leave as 0!

endmenu
```

## arch/mips/lemote/lm2f/Kconfig
```kconfig
choice
	prompt "Machine Type"
	depends on STLS2F_SYSTEMS
	default EMTEC_GDIUM

config EMTEC_GDIUM
	bool "Emtec Gdium Liberty 1000 Netbook"
    select CEVT_R4K
    select CSRC_R4K
    select SYS_HAS_CPU_LOONGSON2
    select DMA_NONCOHERENT
    select BOOT_ELF32
    select BOARD_SCACHE
    select HAVE_STD_PC_SERIAL_PORT
    select HW_HAS_PCI
    select IRQ_CPU
    select SYS_SUPPORTS_32BIT_KERNEL
    select SYS_SUPPORTS_64BIT_KERNEL
    select SYS_SUPPORTS_LITTLE_ENDIAN
    select SYS_SUPPORTS_HIGHMEM
    select SYS_HAS_EARLY_PRINTK
	select GENERIC_GPIO
	select ARCH_REQUIRE_GPIOLIB
    select CPU_HAS_WB
	help
	  Specific support for the Emtec Gdium Liberty 1000 netbook, based on
	  the Loongson-2F CPU.

config GDIUM_VERSION
	int "Gdium Motherboard Revision"
	depends on EMTEC_GDIUM
	default 3
	help
	  Select the revision of the Emtec Gdium motherboard you have. If you are
	  unsure of what to say, leave this as 3.

config GDIUM_UART
	bool "Register UART during boot"
	depends on EMTEC_GDIUM
	default n
	help
	  If your Gdium has UART hardware installed, say y here. Otherwise, say n.

config GDIUM_PMON
	tristate "Register Gdium PMON MTD Partitions"
	depends on EMTEC_GDIUM
	default y
	help
	  Enables the MTD mapping in order to make it possible to upgrade the Emtec
	  Gdium's firmware from Linux. If unsure, say y.

endchoice
```

## arch/mips/loongson/Kconfig
```kconfig
choice
	prompt "Machine Type"
	depends on MACH_LOONGSON

config LEMOTE_FULOONG2E
	bool "Lemote Fuloong(2e) mini-PC"
	select ARCH_SPARSEMEM_ENABLE
	select CEVT_R4K
	select CSRC_R4K
	select SYS_HAS_CPU_LOONGSON2E
	select DMA_NONCOHERENT
	select BOOT_ELF32
	select BOARD_SCACHE
	select HAVE_STD_PC_SERIAL_PORT
	select HW_HAS_PCI
	select I8259
	select ISA
	select IRQ_CPU
	select SYS_SUPPORTS_32BIT_KERNEL
	select SYS_SUPPORTS_64BIT_KERNEL
	select SYS_SUPPORTS_LITTLE_ENDIAN
	select SYS_SUPPORTS_HIGHMEM
	select SYS_HAS_EARLY_PRINTK
	select GENERIC_HARDIRQS_NO__DO_IRQ
	select GENERIC_ISA_DMA_SUPPORT_BROKEN
	select CPU_HAS_WB
	help
	  Lemote Fulong mini-PC board based on the Chinese Loongson-2E CPU and
	  an FPGA northbridge

config LEMOTE_FULOONG2F
	bool "Lemote Fuloong(2f) mini-PC"
	select ARCH_SPARSEMEM_ENABLE
	select CEVT_R4K
	select CSRC_R4K
	select SYS_HAS_CPU_LOONGSON2F
	select DMA_NONCOHERENT
	select BOOT_ELF32
	select BOARD_SCACHE
	select HW_HAS_PCI
	select I8259
	select ISA
	select IRQ_CPU
	select SYS_SUPPORTS_32BIT_KERNEL
	select SYS_SUPPORTS_64BIT_KERNEL
	select SYS_SUPPORTS_LITTLE_ENDIAN
	select SYS_SUPPORTS_HIGHMEM
	select SYS_HAS_EARLY_PRINTK
	select GENERIC_HARDIRQS_NO__DO_IRQ
	select GENERIC_ISA_DMA_SUPPORT_BROKEN
	select CPU_HAS_WB
	select CS5536
	help
	  Lemote Fulong mini-PC board based on the Chinese Loongson-2F CPU

endchoice

config CS5536
	bool

config CS5536_FLASH
	bool
	depends on CS5536

config CS5536_NOR_FLASH
	bool
	depends on CS5536_FLASH

config CS5536_OTG
	bool
	depends on CS5536

config CS5536_UDC
	bool
	depends on CS5536
```

## drivers/platform/Kconfig
```kconfig
if X86
source "drivers/platform/x86/Kconfig"
endif

if PREEMPT_RT
source "drivers/platform/rt/Kconfig"
endif
```

## drivers/platform/loongson/Kconfig
```kconfig
#
# Loongson Platform Specific Drivers
#

menuconfig LOONGSON_PLATFORM_DEVICES
	bool "Loongson Platform Specific Device Drivers"
	default y
	---help---
	  Say Y here to get to see options for device drivers for various
	  loongson platforms, including vendor-specific laptop extension drivers.
	  This option alone does not add any kernel code.

	  If you say N, all options in this submenu will be skipped and disabled.

if LOONGSON_PLATFORM_DEVICES

config EC_KB3310B
	tristate "Embedded Controller: Kb3310b support"
	depends on LEMOTE_YEELOONG2F
	select INPUT_EVDEV
	default y
	---help---
	  This is a driver for yeeloong laptops. It adds the kb3310b support:
	  i.e. battery management, fan & temperature mangement, sci event
	  management and ec rom flushing.

	  This driver is orignally written by Liu junliang <liujl@lemote.com>
	  and maintained by huangwei <huangw@lemote.com> currently.

	  The original git repository is: http://dev.lemote.com/code/ec_module

config EC_KB3310B_DEBUG
	tristate "Embedded Controller: Kb3310b debug support"
	depends on EC_KB3310B
	default n
	---help---
	  This is a driver for yeeloong laptops. It adds the kb3310b debug
	  support.

	  This driver is orignally written by Liu junliang <liujl@lemote.com>
	  and maintained by huangwei <huangw@lemote.com> currently.

	  The original git repository is: http://dev.lemote.com/code/ec_module

config PMON_FLASH
	tristate "MTD map driver for flushing PMON in Linux"
	depends on MTD && MTD_PARTITIONS
	default y
	---help---
	  This is a driver for flushing the bootloader(pmon) of
	  fuloong2e,fuloong2f,yeeloong2f in Linux.

	  Here is a basic usage:

	  1. load necessary modules

	  	$ modprobe mtd
		$ modprobe mtdblock
		$ modprobe pmon_flashd

	  2. read the flash

	  	$ dd if=/dev/mtdblock0 of=pmon.bin

	  3. write the falsh

	  	$ dd if=pmon.bin of=/dev/mtdblock0

endif # LOONGSON_PLATFORM_DEVICES
```

## drivers/platform/rt/Kconfig
```kconfig
menuconfig RT_DEVICES
	bool "PREEMPT_RT Specific Device Drivers"
	default y
	help
	  Say Y here to get to see options for devices drivers for PREEMPT RT.

	  If you say N, all options in this submenu will be skipped and disabled.

if RT_DEVICES

config BACKFIRE
	tristate "Signal Sender Driver"
	help
	  This is a driver for testing your kernel's signal sending
	  performance, which is contributed by Carsten Emde from OSADL.

	  Please get more information from tools/rt/backfire/ and get the
	  latest version from the download page:
	  http://www.osadl.org/Driver-to-Program-Signal-Tester.driver-to-program-signal-tester.0.html

config SCHED_CLOCK_LAT
	tristate "sched_clock() Latency Driver"
	help
	  This is a driver for testing the duration need to call sched_clock()

config INTR_LAT
	tristate "Interrupt Latency Driver"
	help
	  This is a driver for testing your kernel's interrupt latency.
endif
```

## sound/soc/sm501/Kconfig
```kconfig
config SND_SM501_SOC
	tristate "SoC Audio for the Silion Motion SM501 chips"
	depends on MFD_SM501 && SND_SOC
	select SND_PCM
	help
	  Say Y or M if you want to add support for codecs attached to
	  the SM501 AC97 or I2S interface. You will also need
	  to select the audio interfaces to support below.

# config SND_SM501_SOC_I2S
#	tristate

config SND_SM501_SOC_AC97
	tristate
	select AC97_BUS
	select SND_AC97_CODEC
	select SND_SOC_AC97_BUS

config SND_SM501_SOC_AC97_DEVICE
	tristate "SoC AC97 Audio support SM501"
	depends on SND_SM501_SOC
	select SND_SM501_SOC_AC97
	select SND_SOC_AC97_CODEC
	help
	  Say Y if you want to add support for SoC audio on SM501 AC97.
```
